## arch/arm/mach-tegra/Kconfig
```kconfig
if TEGRA

config TEGRA_ARMV7_COMMON
	bool "Tegra 32-bit"
	select SUPPORT_SPL
	select SPL
	select OF_CONTROL
	select CPU_V7
	select DM
	select DM_SPI_FLASH
	select DM_SERIAL
	select DM_I2C
	select DM_SPI
	select DM_GPIO

choice
	prompt "Tegra SoC select"
	optional

config TEGRA20
	bool "Tegra20 family"
	select TEGRA_ARMV7_COMMON

config TEGRA30
	bool "Tegra30 family"
	select TEGRA_ARMV7_COMMON

config TEGRA114
	bool "Tegra114 family"
	select TEGRA_ARMV7_COMMON

config TEGRA124
	bool "Tegra124 family"
	select TEGRA_ARMV7_COMMON

config TEGRA210
	bool "Tegra210 family"
	select OF_CONTROL
	select ARM64
	select DM
	select DM_SPI_FLASH
	select DM_SERIAL
	select DM_I2C
	select DM_SPI
	select DM_GPIO

endchoice

config SYS_MALLOC_F_LEN
	default 0x1800

config USE_PRIVATE_LIBGCC
	default y

config SPL_DM
	default y

config NVTBOOT
	bool "Support being chain-loaded from nvtboot"
	help
	  nvtboot is a bootloader for NVIDIA Tegra platforms. Its purpose is
	  to perform OS-independent system configuration. Among other things,
	  nvtboot may boot a secure OS and set up various memory carve-outs.
	  Once nvtboot has completed execution, it typically chain-loads a
	  use-case-specific bootloader. When doing so, it passes on various
	  configuration information (such as RAM carve-out locations and
	  sizes) via an in-RAM data structure, pointed at by a CPU register.

	  Enabling this option allows U-Boot to support being chain-loaded by
	  nvtboot. This involves e.g. parsing the data structure passed on by
	  nvtboot.

source "arch/arm/mach-tegra/tegra20/Kconfig"
source "arch/arm/mach-tegra/tegra30/Kconfig"
source "arch/arm/mach-tegra/tegra114/Kconfig"
source "arch/arm/mach-tegra/tegra124/Kconfig"
source "arch/arm/mach-tegra/tegra210/Kconfig"

endif
```

## board/nvidia/m3402-0000/Kconfig
```kconfig
if TARGET_M3402_0000

config SYS_BOARD
	default "m3402-0000"

config SYS_VENDOR
	default "nvidia"

config SYS_CONFIG_NAME
	default "m3402-0000"

endif
```

## board/nvidia/m3777-0000/Kconfig
```kconfig
# Copyright (c) 2017, NVIDIA CORPORATION.
#
# SPDX-License-Identifier: GPL-2.0

if TARGET_M3777_0000

config SYS_BOARD
	default "m3777-0000"

config SYS_VENDOR
	default "nvidia"

config SYS_CONFIG_NAME
	default "m3777-0000"

endif
```

## board/nvidia/p3450-0000/Kconfig
```kconfig
if TARGET_P3450_0000

config SYS_BOARD
	default "p3450-0000"

config SYS_VENDOR
	default "nvidia"

config SYS_CONFIG_NAME
	default "p3450-0000"

config P3450_EMMC
	bool "SKU 2 module with eMMC"

endif
```

## board/nvidia/p3450-porg/Kconfig
```kconfig
if TARGET_P3450_PORG

config SYS_BOARD
	default "p3450-porg"

config SYS_VENDOR
	default "nvidia"

config SYS_CONFIG_NAME
	default "p3450-porg"

config NANO_EMMC
	bool "Module has eMMC"

endif
```

## board/nvidia/p3541-0000/Kconfig
```kconfig
if TARGET_P3541_0000

config SYS_BOARD
	default "p3541-0000"

config SYS_VENDOR
	default "nvidia"

config SYS_CONFIG_NAME
	default "p3541-0000"

endif
```

## board/nvidia/p3636-0001/Kconfig
```kconfig
# Copyright (c) 2020, NVIDIA CORPORATION.
#
# SPDX-License-Identifier: GPL-2.0

if TARGET_P3636_0001

config SYS_BOARD
	default "p3636-0001"

config SYS_VENDOR
	default "nvidia"

config SYS_CONFIG_NAME
	default "p3636-0001"

endif
```

## configs/e2220-1170_defconfig
```kconfig
CONFIG_ARM=y
CONFIG_TEGRA=y
CONFIG_TEGRA210=y
CONFIG_TARGET_E2220_1170=y
CONFIG_DEFAULT_DEVICE_TREE="tegra210-e2220-1170"
CONFIG_USE_PRIVATE_LIBGCC=n
CONFIG_NVTBOOT=y
CONFIG_CMD_NET=y
```

## configs/p2371-0000_defconfig
```kconfig
CONFIG_ARM=y
CONFIG_TEGRA=y
CONFIG_TEGRA210=y
CONFIG_TARGET_P2371_0000=y
CONFIG_DEFAULT_DEVICE_TREE="tegra210-p2371-0000"
CONFIG_USE_PRIVATE_LIBGCC=n
CONFIG_NVTBOOT=y
```

## configs/p2371-2180_defconfig
```kconfig
CONFIG_ARM=y
CONFIG_TEGRA=y
CONFIG_TEGRA210=y
CONFIG_TARGET_P2371_2180=y
CONFIG_DEFAULT_DEVICE_TREE="tegra210-p2371-2180"
CONFIG_USE_PRIVATE_LIBGCC=n
```

## configs/p2571_defconfig
```kconfig
CONFIG_ARM=y
CONFIG_TEGRA=y
CONFIG_TEGRA210=y
CONFIG_TARGET_P2571=y
CONFIG_DEFAULT_DEVICE_TREE="tegra210-p2571"
CONFIG_USE_PRIVATE_LIBGCC=n
```
